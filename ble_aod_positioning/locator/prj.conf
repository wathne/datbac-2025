## CMakeLists.txt
```
#
# Copyright (c) 2021 Nordic Semiconductor ASA
#
# SPDX-License-Identifier: LicenseRef-Nordic-5-Clause

cmake_minimum_required(VERSION 3.20.0)

find_package(Zephyr REQUIRED HINTS $ENV{ZEPHYR_BASE})

project(locator)

# NORDIC SDK APP START
target_sources(app PRIVATE
  src/main.c
  src/bt_addr_utils.c
  src/chw1010_ant2_specs.c
  src/ble_channel_constants.c
  src/directional_statistics.c
  src/beacon.c
  src/beacon_database.c
  src/locator.c
  src/iq_data.c
  src/iq_data_work_queue.c
)
# NORDIC SDK APP END
```

## prj.conf
```kconfig
#
# Copyright (c) 2021 Nordic Semiconductor ASA
#
# SPDX-License-Identifier: LicenseRef-Nordic-5-Clause
#

CONFIG_BT=y
CONFIG_BT_DEVICE_NAME="DF Connectionless Locator App"

CONFIG_BT_EXT_ADV=y
CONFIG_BT_PER_ADV_SYNC=y
CONFIG_BT_OBSERVER=y

# Enable Direction Finding Feature including AoA and AoD
CONFIG_BT_DF=y
CONFIG_BT_DF_CONNECTIONLESS_CTE_RX=y

# Disable AoA Feature (antenna switching) in Rx mode for in Controller and Host
CONFIG_BT_CTLR_DF_ANT_SWITCH_RX=n
CONFIG_BT_DF_CTE_RX_AOA=n

# Enable hardware Floating Point Unit (FPU)
CONFIG_FPU=y

# Enable shared FP registers mode
CONFIG_FPU_SHARING=y

# Use hardware FPU registers
CONFIG_FP_HARDABI=y

# Set stack size for initialization and main thread
# (This is a tentative value. Stack usage should be monitored and analyzed.)
CONFIG_MAIN_STACK_SIZE=4096

# Set stack size for system workqueue
# (This is a tentative value. Stack usage should be monitored and analyzed.)
CONFIG_SYSTEM_WORKQUEUE_STACK_SIZE=8192

# Build with newlib library, to include math.h
CONFIG_NEWLIB_LIBC=y

# Enable floating point formatting in newlib printf
CONFIG_NEWLIB_LIBC_FLOAT_PRINTF=y

# Enable floating point formatting in cbprintf
CONFIG_CBPRINTF_FP_SUPPORT=y
```

## src/main.c
```c
/*
 * Copyright (c) 2021 Nordic Semiconductor ASA
 *
 * SPDX-License-Identifier: LicenseRef-Nordic-5-Clause
 */

#include <stddef.h>
#include <errno.h>
#include <zephyr/kernel.h>

#include <zephyr/bluetooth/bluetooth.h>
#include <zephyr/bluetooth/direction.h>

#include <zephyr/sys/printk.h> // For printk().

#include "beacon.h"
#include "beacon_database.h"
#include "bt_addr_utils.h" // For BT_ADDR_SIZE (6).
#include "iq_data.h"
#include "iq_data_work_queue.h"
#include "locator.h"

// TODO(wathne): Revise all #include directives, with comments.

// TODO(wathne): Implement a per_adv_context_manager to manage when to sync to
// known beacons and when to scan for new beacons. Responses will include
// enumerated actions, for example 0 ~ "stop syncing and start scanning", and
// 1 ~ "stop scanning and start syncing".

// NOTE(wathne): This main.c file has intentionally been reverted to a version
// that is minimally different from the initial BLE AoD connectionless receiver
// sample. "git diff" and "git difftool" will reveal minimally invasive
// additions to the initial sample code. Tabular indentation has also been
// preserved to avoid artifical differences. This aims to make it easy to
// contrast this version against the initial sample code. Maybe this will be
// appreciated by the next person working on this code. Unfortunately, this
// version is not able to properly cycle between beacons. It tends to sync to
// the same beacon indefinitely. It will repeatedly calculate direction cosines,
// azimuth, and elevation from the first beacon it encounters, but it will not
// be able to calculate a locator position without direction cosines from a
// second beacon. The locator can be tricked into syncing with a second beacon
// by power cycling both beacons. Each beacon transition will result in a new
// locator position. There has been a version of main.c capable of cycling
// between beacons, but that version was rushed in preparation of a simple
// proof-of-concept demonstration. The rushed modifications were reverted
// beacuse they were not appropriate for the longterm development of the
// locator.

#define DEVICE_NAME CONFIG_BT_DEVICE_NAME
#define DEVICE_NAME_LEN (sizeof(DEVICE_NAME) - 1)
#define PEER_NAME_LEN_MAX 30
/* The Bluetooth Core specification allows controller to wait 6
 * periodic advertising events for
 * synchronization establishment, hence timeout must be longer than that.
 */
#define SYNC_CREATE_TIMEOUT_INTERVAL_NUM 7
/* Maximum length of advertising data represented in hexadecimal format */
#define ADV_DATA_HEX_STR_LEN_MAX (BT_GAP_ADV_MAX_EXT_ADV_DATA_LEN * 2 + 1)

// IQ data work queue.
static struct iq_data_work_queue iq_data_work_queue;

static struct bt_le_per_adv_sync *sync;
static bt_addr_le_t per_addr;
static volatile bool per_adv_found;
static bool scan_enabled;
static uint8_t per_sid;
static uint32_t sync_create_timeout_ms;

static K_SEM_DEFINE(sem_per_adv, 0, 1);
static K_SEM_DEFINE(sem_per_sync, 0, 1);
static K_SEM_DEFINE(sem_per_sync_lost, 0, 1);

#if defined(CONFIG_BT_DF_CTE_RX_AOA)
/* Example sequence of antenna switch patterns for antenna matrix designed by
 * Nordic. For more information about antenna switch patterns see README.rst.
 */
static const uint8_t ant_patterns[] = { 0x2, 0x0, 0x5, 0x6, 0x1, 0x4,
					0xC, 0x9, 0xE, 0xD, 0x8, 0xA };
#endif /* CONFIG_BT_DF_CTE_RX_AOA */

static inline uint32_t adv_interval_to_ms(uint16_t interval)
{
	return interval * 5 / 4;
}

static const char *phy2str(uint8_t phy)
{
	switch (phy) {
	case 0: return "No packets";
	case BT_GAP_LE_PHY_1M: return "LE 1M";
	case BT_GAP_LE_PHY_2M: return "LE 2M";
	case BT_GAP_LE_PHY_CODED: return "LE Coded";
	default: return "Unknown";
	}
}

static const char *cte_type2str(uint8_t type)
{
	switch (type) {
	case BT_DF_CTE_TYPE_AOA: return "AOA";
	case BT_DF_CTE_TYPE_AOD_1US: return "AOD 1 [us]";
	case BT_DF_CTE_TYPE_AOD_2US: return "AOD 2 [us]";
	case BT_DF_CTE_TYPE_NONE: return "";
	default: return "Unknown";
	}
}

static const char *packet_status2str(uint8_t status)
{
	switch (status) {
	case BT_DF_CTE_CRC_OK: return "CRC OK";
	case BT_DF_CTE_CRC_ERR_CTE_BASED_TIME: return "CRC not OK, CTE Info OK";
	case BT_DF_CTE_CRC_ERR_CTE_BASED_OTHER: return "CRC not OK, Sampled other way";
	case BT_DF_CTE_INSUFFICIENT_RESOURCES: return "No resources";
	default: return "Unknown";
	}
}

static bool data_cb(struct bt_data *data, void *user_data)
{
	char *name = user_data;
	uint8_t len;

	switch (data->type) {
	case BT_DATA_NAME_SHORTENED:
	case BT_DATA_NAME_COMPLETE:
		len = MIN(data->data_len, PEER_NAME_LEN_MAX - 1);
		memcpy(name, data->data, len);
		name[len] = '\0';
		return false;
	default:
		return true;
	}
}

static void sync_cb(struct bt_le_per_adv_sync *sync,
		    struct bt_le_per_adv_sync_synced_info *info)
{
	char le_addr[BT_ADDR_LE_STR_LEN];

	bt_addr_le_to_str(info->addr, le_addr, sizeof(le_addr));

	printk("PER_ADV_SYNC[%u]: [DEVICE]: %s synced, "
	       "Interval 0x%04x (%u ms), PHY %s\n",
	       bt_le_per_adv_sync_get_index(sync), le_addr, info->interval,
	       adv_interval_to_ms(info->interval), phy2str(info->phy));

	k_sem_give(&sem_per_sync);
}

static void term_cb(struct bt_le_per_adv_sync *sync,
		    const struct bt_le_per_adv_sync_term_info *info)
{
	char le_addr[BT_ADDR_LE_STR_LEN];

	bt_addr_le_to_str(info->addr, le_addr, sizeof(le_addr));

	printk("PER_ADV_SYNC[%u]: [DEVICE]: %s sync terminated\n",
	       bt_le_per_adv_sync_get_index(sync), le_addr);

	k_sem_give(&sem_per_sync_lost);
}

static void recv_cb(struct bt_le_per_adv_sync *sync,
		    const struct bt_le_per_adv_sync_recv_info *info,
		    struct net_buf_simple *buf)
{
	static char data_str[ADV_DATA_HEX_STR_LEN_MAX];
	char le_addr[BT_ADDR_LE_STR_LEN];

	bt_addr_le_to_str(info->addr, le_addr, sizeof(le_addr));
	bin2hex(buf->data, buf->len, data_str, sizeof(data_str));

	printk("PER_ADV_SYNC[%u]: [DEVICE]: %s, tx_power %i, "
	       "RSSI %i, CTE %s, data length %u, data: %s\n",
	       bt_le_per_adv_sync_get_index(sync), le_addr, info->tx_power,
	       info->rssi, cte_type2str(info->cte_type), buf->len, data_str);
}

static void cte_recv_cb(struct bt_le_per_adv_sync *sync,
			struct bt_df_per_adv_sync_iq_samples_report const *report)
{
	// Timestamp of when the IQ samples report arrived in this cte_recv_cb()
	// callback function. Elapsed time since the system booted, in milliseconds.
	int64_t report_timestamp = k_uptime_get();

	struct bt_le_per_adv_sync_info info;

	printk("Retrieving Periodic Advertising Sync Info...");
	int err = bt_le_per_adv_sync_get_info(sync, &info);
	if (err) {
		printk("failed (err %d)\n", err);
	}
	printk("success\n");

	char addr_s[BT_ADDR_LE_STR_LEN];
	bt_addr_le_to_str(&info.addr, addr_s, sizeof(addr_s));
	printk("Periodic Advertiser Address: %s\n", addr_s);
	//printk("Advertiser SID: %u\n", info.sid);
	//printk("Advertiser PHY: %u\n", info.phy);
	//printk("Periodic advertising interval (N * 1.25 ms): %u\n", info.interval);

	printk("Channel index: %u\n", report->chan_idx);

	/*
	printk("CTE[%u]: samples count %d, cte type %s, slot durations: %u [us], "
	       "packet status %s, RSSI %i\n",
	       bt_le_per_adv_sync_get_index(sync), report->sample_count,
	       cte_type2str(report->cte_type), report->slot_durations,
	       packet_status2str(report->packet_status), report->rssi);
	*/

	// Intermediate structure for raw IQ samples extracted from an IQ samples
	// report.
	struct iq_raw_samples iq_raw_samples;

	// Initialize the raw IQ samples structure from the IQ samples report.
	iq_raw_samples_init(&iq_raw_samples, report, &info, report_timestamp);

	// Submit the raw IQ samples structure to the IQ data work queue.
	// This is a specialized work queue with LIFO processing and FIFO eviction.
	// The work queue is unfair and will process the most recently submitted
	// work first (LIFO processing). It is expected that more work will be
	// submitted to the work queue than the work queue is able to process. The
	// oldest work will be evicted from the work queue when the work queue is
	// full (FIFO eviction).
	iq_data_work_queue_submit(&iq_data_work_queue, &iq_raw_samples);
}

static struct bt_le_per_adv_sync_cb sync_callbacks = {
	.synced = sync_cb,
	.term = term_cb,
	.recv = recv_cb,
	.cte_report_cb = cte_recv_cb,
};

static void scan_recv(const struct bt_le_scan_recv_info *info,
		      struct net_buf_simple *buf)
{
	char le_addr[BT_ADDR_LE_STR_LEN];
	char name[PEER_NAME_LEN_MAX];

	(void)memset(name, 0, sizeof(name));

	bt_data_parse(buf, data_cb, name);

	bt_addr_le_to_str(info->addr, le_addr, sizeof(le_addr));

	printk("[DEVICE]: %s, AD evt type %u, Tx Pwr: %i, RSSI %i %s C:%u S:%u "
	       "D:%u SR:%u E:%u Prim: %s, Secn: %s, Interval: 0x%04x (%u ms), "
	       "SID: %u\n",
	       le_addr, info->adv_type, info->tx_power, info->rssi, name,
	       (info->adv_props & BT_GAP_ADV_PROP_CONNECTABLE) != 0,
	       (info->adv_props & BT_GAP_ADV_PROP_SCANNABLE) != 0,
	       (info->adv_props & BT_GAP_ADV_PROP_DIRECTED) != 0,
	       (info->adv_props & BT_GAP_ADV_PROP_SCAN_RESPONSE) != 0,
	       (info->adv_props & BT_GAP_ADV_PROP_EXT_ADV) != 0, phy2str(info->primary_phy),
	       phy2str(info->secondary_phy), info->interval, adv_interval_to_ms(info->interval),
	       info->sid);

	if (!per_adv_found && info->interval) {
		sync_create_timeout_ms =
			adv_interval_to_ms(info->interval) * SYNC_CREATE_TIMEOUT_INTERVAL_NUM;
		per_adv_found = true;
		per_sid = info->sid;
		bt_addr_le_copy(&per_addr, info->addr);

		k_sem_give(&sem_per_adv);
	}
}

static struct bt_le_scan_cb scan_callbacks = {
	.recv = scan_recv,
};

static void create_sync(void)
{
	struct bt_le_per_adv_sync_param sync_create_param;
	int err;

	printk("Creating Periodic Advertising Sync...");
	bt_addr_le_copy(&sync_create_param.addr, &per_addr);
	sync_create_param.options = 0;
	sync_create_param.sid = per_sid;
	sync_create_param.skip = 0;
	sync_create_param.timeout = 0xa;
	err = bt_le_per_adv_sync_create(&sync_create_param, &sync);
	if (err) {
		printk("failed (err %d)\n", err);
		return;
	}
	printk("success.\n");
}

static int delete_sync(void)
{
	int err;

	printk("Deleting Periodic Advertising Sync...");
	err = bt_le_per_adv_sync_delete(sync);
	if (err) {
		printk("failed (err %d)\n", err);
		return err;
	}
	printk("success\n");

	return 0;
}

static void enable_cte_rx(void)
{
	int err;

	const struct bt_df_per_adv_sync_cte_rx_param cte_rx_params = {
		.max_cte_count = 5,
#if defined(CONFIG_BT_DF_CTE_RX_AOA)
		.cte_types = BT_DF_CTE_TYPE_ALL,
		.slot_durations = 0x2,
		.num_ant_ids = ARRAY_SIZE(ant_patterns),
		.ant_ids = ant_patterns,
#else
		.cte_types = BT_DF_CTE_TYPE_AOD_1US | BT_DF_CTE_TYPE_AOD_2US,
#endif /* CONFIG_BT_DF_CTE_RX_AOA */
	};

	printk("Enable receiving of CTE...\n");
	err = bt_df_per_adv_sync_cte_rx_enable(sync, &cte_rx_params);
	if (err) {
		printk("failed (err %d)\n", err);
		return;
	}
	printk("success. CTE receive enabled.\n");
}

static int scan_init(void)
{
	printk("Scan callbacks register...");
	bt_le_scan_cb_register(&scan_callbacks);
	printk("success.\n");

	printk("Periodic Advertising callbacks register...");
	bt_le_per_adv_sync_cb_register(&sync_callbacks);
	printk("success.\n");

	return 0;
}

static int scan_enable(void)
{
	struct bt_le_scan_param param = {
		.type = BT_LE_SCAN_TYPE_ACTIVE,
		.options = BT_LE_SCAN_OPT_FILTER_DUPLICATE,
		.interval = BT_GAP_SCAN_FAST_INTERVAL,
		.window = BT_GAP_SCAN_FAST_WINDOW,
		.timeout = 0U,
	};

	int err;

	if (!scan_enabled) {
		printk("Start scanning...");
		err = bt_le_scan_start(&param, NULL);
		if (err) {
			printk("failed (err %d)\n", err);
			return err;
		}
		printk("success\n");
		scan_enabled = true;
	}

	return 0;
}

static void scan_disable(void)
{
	int err;

	printk("Scan disable...");
	err = bt_le_scan_stop();
	if (err) {
		printk("failed (err %d)\n", err);
		return;
	}
	printk("Success.\n");

	scan_enabled = false;
}

int main(void)
{
	int err;

	printk("Starting Connectionless Locator Demo\n");

	printk("Initializing global beacon database...");
	err = beacon_database_init_global();
	if (err) {
		printk("failed (err %d)\n", err);
		return 0;
	}
	printk("success\n");

	// TODO(wathne): Populating the beacon database with beacon data from within
	// this main() function is a temporary solution. Beacon data for the beacon
	// database should instead be sourced from a local file or from an external
	// server.

	// Beacon 1, 1050638918, F6:66:CD:FD:DC:EB.
	printk("Initializing beacon 1 struct (1050638918, F6:66:CD:FD:DC:EB)...");
	struct beacon beacon_1;
	uint8_t beacon_1_mac[BT_ADDR_SIZE] = {0xF6, 0x66, 0xCD, 0xFD, 0xDC, 0xEB};
	err = beacon_init(&beacon_1, beacon_1_mac, 10, 0, 0, 0, 0, 0);
	if (err) {
		printk("failed (err %d)\n", err);
		return 0;
	}
	printk("success\n");

	printk("Adding beacon 1 struct to global beacon database...");
	err = beacon_database_put(&g_beacon_db, &beacon_1);
	if (err) {
		printk("failed (err %d)\n", err);
		return 0;
	}
	printk("success\n");

	// TODO(wathne): The debugger on Beacon 2 has become unresponsive. It may be
	// possible to flash Beacon 2 from another NRF52833DK. Beacon 2 is currently
	// decomissioned.
	// Beacon 2, 1050625843, CE:96:F5:15:D2:45.
	printk("Initializing beacon 2 struct (1050625843, CE:96:F5:15:D2:45)...");
	struct beacon beacon_2;
	uint8_t beacon_2_mac[BT_ADDR_SIZE] = {0xCE, 0x96, 0xF5, 0x15, 0xD2, 0x45};
	err = beacon_init(&beacon_2, beacon_2_mac, 0, 0, 0, 0, 0, 0);
	if (err) {
		printk("failed (err %d)\n", err);
		return 0;
	}
	printk("success\n");

	printk("Adding beacon 2 struct to global beacon database...");
	err = beacon_database_put(&g_beacon_db, &beacon_2);
	if (err) {
		printk("failed (err %d)\n", err);
		return 0;
	}
	printk("success\n");

	// Beacon 3,  685689749, D5:55:32:1F:94:9F.
	printk("Initializing beacon 3 struct ( 685689749, D5:55:32:1F:94:9F)...");
	struct beacon beacon_3;
	uint8_t beacon_3_mac[BT_ADDR_SIZE] = {0xD5, 0x55, 0x32, 0x1F, 0x94, 0x9F};
	err = beacon_init(&beacon_3, beacon_3_mac, 0, 0, 0, 0, 0, 0);
	if (err) {
		printk("failed (err %d)\n", err);
		return 0;
	}
	printk("success\n");

	printk("Adding beacon 3 struct to global beacon database...");
	err = beacon_database_put(&g_beacon_db, &beacon_3);
	if (err) {
		printk("failed (err %d)\n", err);
		return 0;
	}
	printk("success\n");

	// Beacon 1, 1050638918, F6:66:CD:FD:DC:EB.
	// Beacon 2, 1050625843, CE:96:F5:15:D2:45.
	// Beacon 3,  685689749, D5:55:32:1F:94:9F.
	printk("Printing global beacon database entries:\n");
	struct beacon beacon_temp;
	uint8_t beacons_mac_big_endian[3][6] = {
			{0xF6, 0x66, 0xCD, 0xFD, 0xDC, 0xEB},
			{0xCE, 0x96, 0xF5, 0x15, 0xD2, 0x45},
			{0xD5, 0x55, 0x32, 0x1F, 0x94, 0x9F}};
	uint8_t beacons_mac_little_endian[3][6] = {
			{0xEB, 0xDC, 0xFD, 0xCD, 0x66, 0xF6},
			{0x45, 0xD2, 0x15, 0xF5, 0x96, 0xCE},
			{0x9F, 0x94, 0x1F, 0x32, 0x55, 0xD5}};
	for (int i = 0; i < 3; i++) {
		beacon_database_get(
				&g_beacon_db,
				&beacon_temp,
				beacons_mac_little_endian[i]);
		printk(
				"mac = %02X:%02X:%02X:%02X:%02X:%02X\n"
				"\n"
				"(x, y, z) = (%.2f, %.2f, %.2f)\n"
				"\n"
				"    [ i_x j_x k_x ]   [ %6.2f %6.2f %6.2f ]\n"
				"R = [ i_y j_y k_y ] = [ %6.2f %6.2f %6.2f ]\n"
				"    [ i_z j_z k_z ]   [ %6.2f %6.2f %6.2f ]\n"
				"\n",
				beacon_temp.mac_big_endian[0], beacon_temp.mac_big_endian[1],
				beacon_temp.mac_big_endian[2], beacon_temp.mac_big_endian[3],
				beacon_temp.mac_big_endian[4], beacon_temp.mac_big_endian[5],
				beacon_temp.x, beacon_temp.y, beacon_temp.z,
				beacon_temp.i_x, beacon_temp.j_x, beacon_temp.k_x,
				beacon_temp.i_y, beacon_temp.j_y, beacon_temp.k_y,
				beacon_temp.i_z, beacon_temp.j_z, beacon_temp.k_z);
	}

	printk("Initializing global locator with global beacon database...");
	err = locator_init_global(&g_beacon_db);
	if (err) {
		printk("failed (err %d)\n", err);
		return 0;
	}
	printk("success\n");

	printk("Initializing work queue with LIFO processing and FIFO eviction...");
	iq_data_work_queue_init(
			&iq_data_work_queue,
			&k_sys_work_q,
			iq_data_process);
	printk("success\n");

	printk("Bluetooth initialization...");
	err = bt_enable(NULL);
	if (err) {
		printk("failed (err %d)\n", err);
	}
	printk("success\n");

	scan_init();

	scan_enabled = false;

	while (true) {
		per_adv_found = false;
		scan_enable();

		printk("Waiting for periodic advertising...\n");
		err = k_sem_take(&sem_per_adv, K_FOREVER);
		if (err) {
			printk("failed (err %d)\n", err);
			return 0;
		}
		printk("success. Found periodic advertising.\n");

		create_sync();

		printk("Waiting for periodic sync...\n");
		err = k_sem_take(&sem_per_sync, K_MSEC(sync_create_timeout_ms));
		if (err) {
			printk("failed (err %d)\n", err);
			err = delete_sync();
			if (err) {
				return 0;
			}
			continue;
		}
		printk("success. Periodic sync established.\n");

		enable_cte_rx();

		/* Disable scan to cleanup output */
		scan_disable();

		printk("Waiting for periodic sync lost...\n");
		err = k_sem_take(&sem_per_sync_lost, K_FOREVER);
		if (err) {
			printk("failed (err %d)\n", err);
			return 0;
		}
		printk("Periodic sync lost.\n");
	}
}
```

## src/beacon.c
```c
#include "beacon.h" // For beacon structure.
#include <errno.h> // For EINVAL (22).
#include <math.h> // For cosf(), sinf(), and M_PI (3.1415927f).
#include <stddef.h> // For NULL ((void *)0).
#include <stdint.h> // For uint8_t.
#include <string.h> // For memcpy().
#include "bt_addr_utils.h" // For BT_ADDR_SIZE (6).

#ifndef M_PI
#define M_PI 3.14159265358979323846f
#endif

int beacon_init(
        struct beacon *beacon,
        const uint8_t mac_big_endian[BT_ADDR_SIZE],
        float global_x,
        float global_y,
        float global_z,
        float yaw,
        float pitch,
        float roll) {
    if (beacon == NULL || mac_big_endian == NULL) {
        return -EINVAL; // -22 ~ "Invalid argument".
    }

    // MAC address in big-endian format (conventional/human-readable order,
    // e.g., F6:66:CD:FD:DC:EB).
    memcpy(beacon->mac_big_endian, mac_big_endian, BT_ADDR_SIZE);

    // MAC address in little-endian format (protocol/reversed octet order,
    // e.g., EB:DC:FD:CD:66:F6).
    // "Multi-octet fields ... shall be transmitted with the least significant
    // octet first."
    // - Bluetooth Core Specification 5.4, Vol 6, Part B, Sections 1.2 - 1.3.
    // The Nordic Semiconductor BLE implementation follows the same reversed
    // octet ordering when storing BLE device addresses.
    for (int i = 0; i < BT_ADDR_SIZE; i++) {
        beacon->mac_little_endian[i] = mac_big_endian[BT_ADDR_SIZE - 1 - i];
    }

    beacon->x = global_x;
    beacon->y = global_y;
    beacon->z = global_z;

    int ret = beacon_set_global_orientation(beacon, yaw, pitch, roll);

    return ret;
}

int beacon_set_global_orientation(
        struct beacon *beacon,
        float yaw,
        float pitch,
        float roll) {
    if (beacon == NULL) {
        return -EINVAL; // -22 ~ "Invalid argument".
    }

    if (yaw < -M_PI || yaw > M_PI) {
        return -EINVAL; // -22 ~ "Invalid argument".
    }
    if (pitch < -M_PI/2 || pitch > M_PI/2) {
        return -EINVAL; // -22 ~ "Invalid argument".
    }
    if (roll < -M_PI || roll > M_PI) {
        return -EINVAL; // -22 ~ "Invalid argument".
    }

    // Set global orientation for the beacon by converting Yaw, Pitch, and Roll
    // to orthonormal basis vectors (i, j, k).
    //
    // Tait–Bryan angles α, β, and γ, when applied in an intrinsic rotation
    // sequence z-y'-x'', are known as Yaw, Pitch, and Roll. The equivalent
    // extrinsic rotation sequence is x-y-z. These angles follow a right-hand
    // rule. Point the right thumb along the positive direction of the axis of
    // rotation, then curl the fingers in the direction of positive rotation.
    // Yaw is a counterclockwise rotation of α about the Z-axis when viewed from
    // the positive Z-axis toward the origin, range [-pi, pi].
    // Pitch is a counterclockwise rotation of β about the Y-axis when viewed
    // from the positive Y-axis toward the origin, range [-pi/2 , pi/2].
    // Roll is a counterclockwise rotation of γ about the X-axis when viewed
    // from the positive X-axis toward the origin, range [-pi, pi].
    // An intrinsic rotation sequence z-y'-x'' is applied in the local
    // coordinate system in a Yaw-Pitch-Roll order. First apply Yaw, then apply
    // Pitch, and finally apply Roll. In other words, first rotate about the
    // global Z-axis, then rotate about the new Y'-axis, and finally rotate
    // about the new X''-axis.
    // An extrinsic rotation sequence x-y-z is applied in the global coordinate
    // system in a Roll-Pitch-Yaw order. First apply Roll, then apply Pitch, and
    // finally apply Yaw. In other words, first rotate about the global X-axis,
    // then rotate about the global Y-axis, and finally rotate about the global
    // Z-axis.
    // The extrinsic rotation sequence forms the rotation matrix R from local
    // coordinates to global coordinates. Note that matrix multiplication
    // is not commutative. Matrix multiplication is evaluated from right to
    // left, similar to function compositions.
    //
    // R = Rz(α) Ry(β) Rx(γ)
    //
    //                [  cos(α) -sin(α)    0    ]
    // Yaw:   Rz(α) = [  sin(α)  cos(α)    0    ]
    //                [    0       0       1    ]
    //
    //                [  cos(β)    0     sin(β) ]
    // Pitch: Ry(β) = [    0       1       0    ]
    //                [ -sin(β)    0     cos(β) ]
    //
    //                [    1       0       0    ]
    // Roll:  Rx(γ) = [    0     cos(γ) -sin(γ) ]
    //                [    0     sin(γ)  cos(γ) ]
    //
    //             Yaw                 Pitch                 Roll
    //     [ cos(α) -sin(α) 0 ] [  cos(β) 0 sin(β) ] [ 1   0       0    ]
    // R = [ sin(α)  cos(α) 0 ] [    0    1   0    ] [ 0 cos(γ) -sin(γ) ]
    //     [   0       0    1 ] [ -sin(β) 0 cos(β) ] [ 0 sin(γ)  cos(γ) ]
    //
    //     [ cos(α)*cos(β) cos(α)*sin(β)*sin(γ)-sin(α)*cos(γ) cos(α)*sin(β)*cos(γ)+sin(α)*sin(γ) ]
    // R = [ sin(α)*cos(β) sin(α)*sin(β)*sin(γ)+cos(α)*cos(γ) sin(α)*sin(β)*cos(γ)-cos(α)*sin(γ) ]
    //     [    -sin(β)              cos(β)*sin(γ)                      cos(β)*cos(γ)            ]
    //
    //     [ i_x  j_x  k_x ]
    // R = [ i_y  j_y  k_y ]
    //     [ i_z  j_z  k_z ]
    //
    // i_x = cos(α)*cos(β)
    // i_y = sin(α)*cos(β)
    // i_z = -sin(β)
    //
    // j_x = cos(α)*sin(β)*sin(γ) - sin(α)*cos(γ)
    // j_y = sin(α)*sin(β)*sin(γ) + cos(α)*cos(γ)
    // j_z = cos(β)*sin(γ)
    //
    // k_x = cos(α)*sin(β)*cos(γ) + sin(α)*sin(γ)
    // k_y = sin(α)*sin(β)*cos(γ) - cos(α)*sin(γ)
    // k_z = cos(β)*cos(γ)

    float cos_yaw = cosf(yaw);     // cos(α)
    float sin_yaw = sinf(yaw);     // sin(α)
    float cos_pitch = cosf(pitch); // cos(β)
    float sin_pitch = sinf(pitch); // sin(β)
    float cos_roll = cosf(roll);   // cos(γ)
    float sin_roll = sinf(roll);   // sin(γ)

    beacon->i_x = cos_yaw*cos_pitch;
    beacon->i_y = sin_yaw*cos_pitch;
    beacon->i_z = -sin_pitch;

    beacon->j_x = cos_yaw*sin_pitch*sin_roll - sin_yaw*cos_roll;
    beacon->j_y = sin_yaw*sin_pitch*sin_roll + cos_yaw*cos_roll;
    beacon->j_z = cos_pitch*sin_roll;

    beacon->k_x = cos_yaw*sin_pitch*cos_roll + sin_yaw*sin_roll;
    beacon->k_y = sin_yaw*sin_pitch*cos_roll - cos_yaw*sin_roll;
    beacon->k_z = cos_pitch*cos_roll;

    return 0; // 0 ~ "Success".
}

void beacon_get_global_direction_cosines(
        const struct beacon *beacon,
        float local_direction_cosine_x,
        float local_direction_cosine_y,
        float local_direction_cosine_z,
        float *global_direction_cosine_x,
        float *global_direction_cosine_y,
        float *global_direction_cosine_z) {
    // Get global direction cosines by transforming local direction cosines to
    // global direction cosines. Input validation is intentionally omitted. The
    // local direction cosines must form a normalized direction vector. The
    // beacon argument must be a pointer to an initialized beacon structure.
    // See the beacon_init() function.
    // The set of direction cosines form a normalized direction vector D such
    // that cos(a)^2 + cos(b)^2 + cos(c)^2 = 1.
    // Direction cos(a) is the cosine of the angle a between D and the X-axis.
    // Direction cos(b) is the cosine of the angle b between D and the Y-axis.
    // Direction cos(c) is the cosine of the angle c between D and the Z-axis.
    //
    //     [ cos(a) ]
    // D = [ cos(b) ]
    //     [ cos(c) ]
    //
    // D_global = R D_local
    //
    // [ dx_global ]   [ i_x  j_x  k_x ] [ dx_local ]
    // [ dy_global ] = [ i_y  j_y  k_y ] [ dy_local ]
    // [ dz_global ]   [ i_z  j_z  k_z ] [ dz_local ]
    //
    // dx_global =
    //         dx_local * i_x +
    //         dy_local * j_x +
    //         dz_local * k_x;
    //
    // dy_global =
    //         dx_local * i_y +
    //         dy_local * j_y +
    //         dz_local * k_y;
    //
    // dz_global =
    //         dx_local * i_z +
    //         dy_local * j_z +
    //         dz_local * k_z;
    *global_direction_cosine_x =
            local_direction_cosine_x * beacon->i_x +
            local_direction_cosine_y * beacon->j_x +
            local_direction_cosine_z * beacon->k_x;

    *global_direction_cosine_y =
            local_direction_cosine_x * beacon->i_y +
            local_direction_cosine_y * beacon->j_y +
            local_direction_cosine_z * beacon->k_y;

    *global_direction_cosine_z =
            local_direction_cosine_x * beacon->i_z +
            local_direction_cosine_y * beacon->j_z +
            local_direction_cosine_z * beacon->k_z;
}
```

## src/beacon.h
```c
#ifndef BEACON_H
#define BEACON_H

#include <stdint.h> // For uint8_t.
#include "bt_addr_utils.h" // For BT_ADDR_SIZE (6).

// Manage relative position and orientation of beacons in a "global" coordinate
// system. Note that this "global" coordinate system is not yet positioned or
// oriented relative to the actual global geographic coordinate system (GCS) of
// the Earth. The actual global GCS latitude, longitude, height, and orientation
// must be managed in a separate data structure to anchor the "global"
// coordinate system itself to somewhere on the surface of the Earth.

// Beacon structure.
// MAC address, global coordinates, and global orientation.
// See the beacon_init() function.
struct beacon {
    // MAC address in big-endian format (conventional/human-readable order,
    // e.g., F6:66:CD:FD:DC:EB).
    uint8_t mac_big_endian[BT_ADDR_SIZE];

    // MAC address in little-endian format (protocol/reversed octet order,
    // e.g., EB:DC:FD:CD:66:F6).
    // "Multi-octet fields ... shall be transmitted with the least significant
    // octet first."
    // - Bluetooth Core Specification 5.4, Vol 6, Part B, Sections 1.2 - 1.3.
    // The Nordic Semiconductor BLE implementation follows the same reversed
    // octet ordering when storing BLE device addresses.
    uint8_t mac_little_endian[BT_ADDR_SIZE];

    // Position of the local origin (0, 0, 0) in the global coordinate system
    // relative to the global origin, in meters.
    float x; // Global X coordinate.
    float y; // Global Y coordinate.
    float z; // Global Z coordinate.

    // Global orientation as orthonormal basis vectors (i, j, k). These basis
    // vectors form the rotation matrix R from local coordinates to global
    // coordinates.
    //
    //     [ i_x  j_x  k_x ]
    // R = [ i_y  j_y  k_y ]
    //     [ i_z  j_z  k_z ]
    //
    // For transforming local direction cosines to global direction cosines.
    //
    // [ dx_global ]   [ i_x  j_x  k_x ] [ dx_local ]
    // [ dy_global ] = [ i_y  j_y  k_y ] [ dy_local ]
    // [ dz_global ]   [ i_z  j_z  k_z ] [ dz_local ]
    //
    float i_x, i_y, i_z; // Local X-axis (i) (rightward) in global coordinates.
    float j_x, j_y, j_z; // Local Y-axis (j) (upward) in global coordinates.
    float k_x, k_y, k_z; // Local Z-axis (k) (outward) in global coordinates.
};

// Initialize a beacon structure.
// Converts the MAC address from big-endian format to little-endian format, and
// stores both MAC address formats as mac_big_endian and mac_little_endian.
// TODO(wathne): Add more documentation. Meanwhile, see the documentation for
// the beacon structure, and see the documentation for the
// beacon_set_global_orientation() function.
// Returns 0 (0 ~ "Success") if the beacon structure is initialized.
// Returns -EINVAL (-22 ~ "Invalid argument") if beacon pointer is NULL, or if
// mac_big_endian pointer is NULL, or if yaw, pitch, or roll are out of range.
int beacon_init(
        struct beacon *beacon,
        const uint8_t mac_big_endian[BT_ADDR_SIZE],
        float global_x,
        float global_y,
        float global_z,
        float yaw,
        float pitch,
        float roll);

// Set global orientation for a beacon by converting Yaw, Pitch, and Roll to
// orthonormal basis vectors (i, j, k).
// Returns 0 (0 ~ "Success") if the global orientation is set.
// Returns -EINVAL (-22 ~ "Invalid argument") if beacon pointer is NULL, or if
// yaw, pitch, or roll are out of range.
//
// Tait–Bryan angles α, β, and γ, when applied in an intrinsic rotation sequence
// z-y'-x'', are known as Yaw, Pitch, and Roll. The equivalent extrinsic
// rotation sequence is x-y-z. These angles follow a right-hand rule. Point the
// right thumb along the positive direction of the axis of rotation, then curl
// the fingers in the direction of positive rotation.
// Yaw is a counterclockwise rotation of α about the Z-axis when viewed from the
// positive Z-axis toward the origin, range [-pi, pi].
// Pitch is a counterclockwise rotation of β about the Y-axis when viewed from
// the positive Y-axis toward the origin, range [-pi/2 , pi/2].
// Roll is a counterclockwise rotation of γ about the X-axis when viewed from
// the positive X-axis toward the origin, range [-pi, pi].
// An intrinsic rotation sequence z-y'-x'' is applied in the local coordinate
// system in a Yaw-Pitch-Roll order. First apply Yaw, then apply Pitch, and
// finally apply Roll. In other words, first rotate about the global Z-axis,
// then rotate about the new Y'-axis, and finally rotate about the new X''-axis.
// An extrinsic rotation sequence x-y-z is applied in the global coordinate
// system in a Roll-Pitch-Yaw order. First apply Roll, then apply Pitch, and
// finally apply Yaw. In other words, first rotate about the global X-axis, then
// rotate about the global Y-axis, and finally rotate about the global Z-axis.
// The extrinsic rotation sequence forms the rotation matrix R from local
// coordinates to global coordinates. Note that matrix multiplication is not
// commutative. Matrix multiplication is evaluated from right to left, similar
// to function compositions.
//
// R = Rz(α) Ry(β) Rx(γ)
//
//                [  cos(α) -sin(α)    0    ]
// Yaw:   Rz(α) = [  sin(α)  cos(α)    0    ]
//                [    0       0       1    ]
//
//                [  cos(β)    0     sin(β) ]
// Pitch: Ry(β) = [    0       1       0    ]
//                [ -sin(β)    0     cos(β) ]
//
//                [    1       0       0    ]
// Roll:  Rx(γ) = [    0     cos(γ) -sin(γ) ]
//                [    0     sin(γ)  cos(γ) ]
//
//             Yaw                 Pitch                 Roll
//     [ cos(α) -sin(α) 0 ] [  cos(β) 0 sin(β) ] [ 1   0       0    ]
// R = [ sin(α)  cos(α) 0 ] [    0    1   0    ] [ 0 cos(γ) -sin(γ) ]
//     [   0       0    1 ] [ -sin(β) 0 cos(β) ] [ 0 sin(γ)  cos(γ) ]
//
//     [ cos(α)*cos(β) cos(α)*sin(β)*sin(γ)-sin(α)*cos(γ) cos(α)*sin(β)*cos(γ)+sin(α)*sin(γ) ]
// R = [ sin(α)*cos(β) sin(α)*sin(β)*sin(γ)+cos(α)*cos(γ) sin(α)*sin(β)*cos(γ)-cos(α)*sin(γ) ]
//     [    -sin(β)              cos(β)*sin(γ)                      cos(β)*cos(γ)            ]
//
//     [ i_x  j_x  k_x ]
// R = [ i_y  j_y  k_y ]
//     [ i_z  j_z  k_z ]
//
// i_x = cos(α)*cos(β)
// i_y = sin(α)*cos(β)
// i_z = -sin(β)
//
// j_x = cos(α)*sin(β)*sin(γ) - sin(α)*cos(γ)
// j_y = sin(α)*sin(β)*sin(γ) + cos(α)*cos(γ)
// j_z = cos(β)*sin(γ)
//
// k_x = cos(α)*sin(β)*cos(γ) + sin(α)*sin(γ)
// k_y = sin(α)*sin(β)*cos(γ) - cos(α)*sin(γ)
// k_z = cos(β)*cos(γ)
int beacon_set_global_orientation(
        struct beacon *beacon,
        float yaw,
        float pitch,
        float roll);

// Get global direction cosines by transforming local direction cosines to
// global direction cosines. Input validation is intentionally omitted. The
// local direction cosines must form a normalized direction vector. The beacon
// argument must be a pointer to an initialized beacon structure.
// See the beacon_init() function.
// The set of direction cosines form a normalized direction vector D such that
// cos(a)^2 + cos(b)^2 + cos(c)^2 = 1.
// Direction cos(a) is the cosine of the angle a between D and the X-axis.
// Direction cos(b) is the cosine of the angle b between D and the Y-axis.
// Direction cos(c) is the cosine of the angle c between D and the Z-axis.
//
//     [ cos(a) ]
// D = [ cos(b) ]
//     [ cos(c) ]
//
// D_global = R D_local
//
// [ dx_global ]   [ i_x  j_x  k_x ] [ dx_local ]
// [ dy_global ] = [ i_y  j_y  k_y ] [ dy_local ]
// [ dz_global ]   [ i_z  j_z  k_z ] [ dz_local ]
//
// dx_global =
//         dx_local * i_x +
//         dy_local * j_x +
//         dz_local * k_x;
//
// dy_global =
//         dx_local * i_y +
//         dy_local * j_y +
//         dz_local * k_y;
//
// dz_global =
//         dx_local * i_z +
//         dy_local * j_z +
//         dz_local * k_z;
void beacon_get_global_direction_cosines(
        const struct beacon *beacon,
        float local_direction_cosine_x,
        float local_direction_cosine_y,
        float local_direction_cosine_z,
        float *global_direction_cosine_x,
        float *global_direction_cosine_y,
        float *global_direction_cosine_z);

#endif // BEACON_H
```

## src/beacon_database.c
```c
#include "beacon_database.h" // For beacon database structure and BEACON_DATABASE_CAPACITY.
#include <errno.h> // For ENOENT (2), EINVAL (22), and ENOSPC (28).
#include <stddef.h> // For NULL ((void *)0).
#include <stdint.h> // For uint8_t.
#include "beacon.h" // For beacon structure.
#include "bt_addr_utils.h" // For BT_ADDR_SIZE (6) and bt_addr_mac_compare().

// The global beacon database instance.
// See the beacon_database_init_global() function.
struct beacon_database g_beacon_db;

int beacon_database_init(struct beacon_database *beacon_db) {
    if (beacon_db == NULL) {
        return -EINVAL; // -22 ~ "Invalid argument".
    }

    beacon_db->count = 0;

    return 0; // 0 ~ "Success".
}

int beacon_database_init_global() {
    return beacon_database_init(&g_beacon_db);
}

int beacon_database_put(
        struct beacon_database *beacon_db,
        const struct beacon *beacon) {
    if (beacon_db == NULL || beacon == NULL) {
        return -EINVAL; // -22 ~ "Invalid argument".
    }

    int ret;
    for (int i = 0; i < beacon_db->count; i++) {
        ret = bt_addr_mac_compare(
                beacon->mac_little_endian,
                beacon_db->beacons[i].mac_little_endian);
        if (ret == 1) {
            // Update beacon.
            beacon_db->beacons[i] = *beacon;
            return 0; // 0 ~ "Success".
        }
    }

    if (beacon_db->count >= BEACON_DATABASE_CAPACITY) {
        return -ENOSPC; // -28 ~ "No space left on device".
    }

    // Add beacon.
    beacon_db->beacons[beacon_db->count] = *beacon;
    beacon_db->count++;
    return 0; // 0 ~ "Success".
}

int beacon_database_get(
        struct beacon_database *beacon_db,
        struct beacon *beacon,
        const uint8_t mac_little_endian[BT_ADDR_SIZE]) {
    if (beacon_db == NULL || beacon == NULL || mac_little_endian == NULL) {
        return -EINVAL; // -22 ~ "Invalid argument".
    }

    int ret;
    for (int i = 0; i < beacon_db->count; i++) {
        ret = bt_addr_mac_compare(
                mac_little_endian,
                beacon_db->beacons[i].mac_little_endian);
        if (ret == 1) {
            // Get beacon.
            *beacon = beacon_db->beacons[i];
            return 0; // 0 ~ "Success".
        }
    }

    return -ENOENT; // -2 ~ "No such file or directory".
}
```

## src/beacon_database.h
```c
#ifndef BEACON_DATABASE_H
#define BEACON_DATABASE_H

#include <stdint.h> // For uint8_t.
#include "beacon.h" // For beacon structure.
#include "bt_addr_utils.h" // For BT_ADDR_SIZE (6).

#define BEACON_DATABASE_CAPACITY 16

// Beacon database structure.
// See the beacon_database_init() function.
struct beacon_database {
    struct beacon beacons[BEACON_DATABASE_CAPACITY];

    int count;
};

// The global beacon database instance.
// See the beacon_database_init_global() function.
extern struct beacon_database g_beacon_db;

// Initialize a beacon database structure (count = 0).
// Returns 0 (0 ~ "Success") if the beacon database structure is initialized.
// Returns -EINVAL (-22 ~ "Invalid argument") if beacon_db pointer is NULL.
int beacon_database_init(struct beacon_database *beacon_db);

// Initialize the global beacon database instance g_beacon_db (count = 0).
// Returns 0 (0 ~ "Success") if the beacon database structure is initialized.
int beacon_database_init_global();

// Update or add a beacon, to a beacon database.
// Returns 0 (0 ~ "Success") if a beacon in the database is updated, or if the
// beacon is added to the database.
// Returns -ENOSPC (-28 ~ "No space left on device") if the database is full.
// Returns -EINVAL (-22 ~ "Invalid argument") if beacon_db pointer is NULL, or
// if beacon pointer is NULL.
int beacon_database_put(
        struct beacon_database *beacon_db,
        const struct beacon *beacon);

// Get a beacon by MAC address, from a beacon database.
// Uses little-endian MAC address format (protocol/reversed octet order) for
// beacon lookup. This allows direct use of MAC addresses as received from the
// BLE controller.
// Returns 0 (0 ~ "Success") if a beacon is found.
// Returns -ENOENT (-2 ~ "No such file or directory") if no beacon is found.
// Returns -EINVAL (-22 ~ "Invalid argument") if beacon_db pointer is NULL, or
// if beacon pointer is NULL, or if mac_little_endian pointer is NULL.
int beacon_database_get(
        struct beacon_database *beacon_db,
        struct beacon *beacon,
        const uint8_t mac_little_endian[BT_ADDR_SIZE]);

#endif // BEACON_DATABASE_H
```

## src/ble_channel_constants.c
```c
#include "ble_channel_constants.h"
#include <stdint.h> // For uint8_t and uint16_t.

const uint16_t ble_channel_frequencies[40] = {
    2404, 2406, 2408, 2410, 2412,
    2414, 2416, 2418, 2420, 2422,
    2424, 2428, 2430, 2432, 2434,
    2436, 2438, 2440, 2442, 2444,
    2446, 2448, 2450, 2452, 2454,
    2456, 2458, 2460, 2462, 2464,
    2466, 2468, 2470, 2472, 2474,
    2476, 2478, 2402, 2426, 2480
};

const float ble_channel_wavelengths[40] = {
    124.705681f, 124.602019f, 124.498529f, 124.395211f, 124.292064f,
    124.189088f, 124.086282f, 123.983647f, 123.881181f, 123.778884f,
    123.676757f, 123.473006f, 123.371382f, 123.269925f, 123.168635f,
    123.067511f, 122.966554f, 122.865761f, 122.765134f, 122.664672f,
    122.564374f, 122.464239f, 122.364269f, 122.264461f, 122.164816f,
    122.065333f, 121.966012f, 121.866853f, 121.767855f, 121.669017f,
    121.570340f, 121.471823f, 121.373465f, 121.275266f, 121.177226f,
    121.079345f, 120.981621f, 124.809516f, 123.574797f, 120.884056f
};

const float ble_channel_wavenumbers[40] = {
    0.050384f, 0.050426f, 0.050468f, 0.050510f, 0.050552f,
    0.050594f, 0.050636f, 0.050678f, 0.050719f, 0.050761f,
    0.050803f, 0.050887f, 0.050929f, 0.050971f, 0.051013f,
    0.051055f, 0.051097f, 0.051139f, 0.051181f, 0.051222f,
    0.051264f, 0.051306f, 0.051348f, 0.051390f, 0.051432f,
    0.051474f, 0.051516f, 0.051558f, 0.051600f, 0.051642f,
    0.051684f, 0.051725f, 0.051767f, 0.051809f, 0.051851f,
    0.051893f, 0.051935f, 0.050342f, 0.050845f, 0.051977f
};

uint16_t ble_channel_get_frequency(uint8_t ble_channel_index) {
    if (ble_channel_index < 40) {
        return ble_channel_frequencies[ble_channel_index];
    } else {
        // TODO(wathne): Gracefully default to BLE channel index 18 (2442 Mhz)?
        // return ble_channel_frequencies[18];
        return 0;
    }
}

float ble_channel_get_wavelength(uint8_t ble_channel_index) {
    if (ble_channel_index < 40) {
        return ble_channel_wavelengths[ble_channel_index];
    } else {
        // TODO(wathne): Gracefully default to BLE channel index 18 (2442 Mhz)?
        // return ble_channel_wavelengths[18];
        return 0.0f;
    }
}

float ble_channel_get_wavenumber(uint8_t ble_channel_index) {
    if (ble_channel_index < 40) {
        return ble_channel_wavenumbers[ble_channel_index];
    } else {
        // TODO(wathne): Gracefully default to BLE channel index 18 (2442 Mhz)?
        // return ble_channel_wavenumbers[18];
        return 0.0f;
    }
}
```

## src/ble_channel_constants.h
```c
#ifndef BLE_CHANNEL_CONSTANTS_H
#define BLE_CHANNEL_CONSTANTS_H

#include <stdint.h> // For uint8_t and uint16_t.

// Speed of light in meters per second.
// c = 299792458 meters/second.

// pi = 3.1415926535897932384626433832795

// Lookup table (LUT) for BLE channel frequencies in MHz.
// BLE channels 0-36 are secondary advertising channels.
// BLE channels 37-39 are primary advertising channels.
extern const uint16_t ble_channel_frequencies[40];

// Lookup table (LUT) for BLE channel wavelengths in millimeters.
// lambda = c/f, where c = 299792458 meters/second, and f is BLE channel
// frequency in MHz.
// BLE channels 0-36 are secondary advertising channels.
// BLE channels 37-39 are primary advertising channels.
extern const float ble_channel_wavelengths[40];

// Lookup table (LUT) for BLE channel wavenumbers in radians per millimeter.
// k = 2*pi/lambda, where pi = 3.1415926535897932384626433832795, and lambda is
// BLE channel wavelength in millimeters.
// BLE channels 0-36 are secondary advertising channels.
// BLE channels 37-39 are primary advertising channels.
extern const float ble_channel_wavenumbers[40];

// Get BLE channel frequency in MHz.
// BLE channels 0-36 are secondary advertising channels.
// BLE channels 37-39 are primary advertising channels.
uint16_t ble_channel_get_frequency(uint8_t ble_channel_index);

// Get BLE channel wavelength in millimeters.
// lambda = c/f, where c = 299792458 meters/second, and f is BLE channel
// frequency in MHz.
// BLE channels 0-36 are secondary advertising channels.
// BLE channels 37-39 are primary advertising channels.
float ble_channel_get_wavelength(uint8_t ble_channel_index);

// Get BLE channel wavenumber in radians per millimeter.
// k = 2*pi/lambda, where pi = 3.1415926535897932384626433832795, and lambda is
// BLE channel wavelength in millimeters.
// BLE channels 0-36 are secondary advertising channels.
// BLE channels 37-39 are primary advertising channels.
float ble_channel_get_wavenumber(uint8_t ble_channel_index);

#endif // BLE_CHANNEL_CONSTANTS_H
```

## src/bt_addr_utils.c
```c
#include "bt_addr_utils.h" // For BT_ADDR_SIZE (6).
#include <errno.h> // For EINVAL (22).
#include <stddef.h> // For NULL ((void *)0).
#include <stdint.h> // For uint8_t.
#include <string.h> // For memcmp().

int bt_addr_mac_compare(
        const uint8_t mac_1[BT_ADDR_SIZE],
        const uint8_t mac_2[BT_ADDR_SIZE]) {
    if (mac_1 == NULL || mac_2 == NULL) {
        return -EINVAL; // -22 ~ "Invalid argument".
    }

    if (memcmp(mac_1, mac_2, BT_ADDR_SIZE) == 0) {
        return 1; // 1 ~ "True".
    }

    return 0; // 0 ~ "False".
}
```

## src/bt_addr_utils.h
```c
#ifndef BT_ADDR_UTILS_H
#define BT_ADDR_UTILS_H

#include <stdint.h> // For uint8_t.
#include <zephyr/bluetooth/addr.h> // For BT_ADDR_SIZE (6).

#ifndef BT_ADDR_SIZE
#define BT_ADDR_SIZE 6
#endif

// Compare Bluetooth MAC addresses.
// Returns 1 (1 ~ "True") if the MAC addresses are equal.
// Returns 0 (0 ~ "False") if the MAC addresses are not equal.
// Returns -EINVAL (-22 ~ "Invalid argument") if mac_1 pointer is NULL, or if
// mac_2 pointer is NULL.
int bt_addr_mac_compare(
        const uint8_t mac_1[BT_ADDR_SIZE],
        const uint8_t mac_2[BT_ADDR_SIZE]);

#endif // BT_ADDR_UTILS_H
```

## src/chw1010_ant2_specs.h
```c
#ifndef CHW1010_ANT2_SPECS_H
#define CHW1010_ANT2_SPECS_H

// CoreHW CHW1010-ANT2-1.1 antenna grid:
//  +----+----+----+----+
//  | 13 | 12 | 11 |  9 |
//  +----+----+----+----+
//  | 14 | 15 | 10 |  8 |
//  +----+----+----+----+
//  |  1 |  0 |  5 |  7 |
//  +----+----+----+----+
//  |  2 |  3 |  4 |  6 |
//  +----+----+----+----+

// CoreHW CHW1010-ANT2-1.1 antenna coordinate system:
//            Y
//            |
//    13   12 | 11    9
//            |
//    14   15 | 10    8
//            +------------ X
//     1    0    5    7
//
//     2    3    4    6
//
// Right-handed Cartesian (x, y, z) coordinate system.
// X-axis: Points rightward when facing the array.
// Y-axis: Points upward when facing the array.
// Z-axis: Points outward from the array toward the locator.
// Origin (0, 0, 0) is at the center of the array.
// 
// Azimuth is the angle in the XZ-plane with respect to the Z-axis.
//   - Positive when the locator is to the right of the array (x > 0).
//   - Negative when the locator is to the left of the array (x < 0).
//   - Range is [-pi, pi].
// Elevation is the angle from the XZ-plane toward the Y-axis.
//   - Positive when the locator is above the XZ-plane (y > 0).
//   - Negative when the locator is below the XZ-plane (y < 0).
//   - Range is [-pi/2, pi/2].
//
// The above definition for Azimuth and Elevation is intuitive and
// conventional, but note that many BLE direction finding references may use
// an alternative convention:
// (Alt.) Azimuth is the angle in the XY-plane with respect to the X-axis.
// (Alt.) Elevation is the angle from the XY-plane toward the Z-axis.

// CoreHW CHW1010-ANT2-1.1 antenna spacing for orthogonally adjacent antennas,
// from antenna center to antenna center, in millimeters.
extern const float antenna_spacing_orthogonal;

// CoreHW CHW1010-ANT2-1.1 antenna spacing for diagonally adjacent antennas,
// from antenna center to antenna center, in millimeters.
extern const float antenna_spacing_diagonal;

// CoreHW CHW1010-ANT2-1.1 antenna center positions (x, y, z) in millimeters.
extern const float antenna_positions_xyz[16][3];

// CoreHW CHW1010-ANT2-1.1 antenna center positions (x, y) in millimeters,
// z = 0.
extern const float antenna_positions_xy[16][2];

// CoreHW CHW1010-ANT2-1.1 antenna center positions x-coordinate in millimeters,
// z = 0.
extern const float antenna_positions_x[16];

// CoreHW CHW1010-ANT2-1.1 antenna center positions y-coordinate in millimeters,
// z = 0.
extern const float antenna_positions_y[16];

#endif // CHW1010_ANT2_SPECS_H
```
